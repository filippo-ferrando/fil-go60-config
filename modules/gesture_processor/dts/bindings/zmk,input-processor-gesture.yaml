## modules/gesture_processor/dts/bindings/zmk,input-processor-gesture.yaml
```yaml
description: ZMK Input Processor for Touchpad Gestures
compatible: "zmk,input-processor-gesture"

include: base.yaml

properties:
  x-threshold:
    type: int
    required: true
  y-threshold:
    type: int
    required: true
  cooldown-ms:
    type: int
    required: true

  swipe-left-behaviors:
    type: phandle-array
    specifier-space: binding
    required: false
  swipe-right-behaviors:
    type: phandle-array
    specifier-space: binding
    required: false
  swipe-up-behaviors:
    type: phandle-array
    specifier-space: binding
    required: false
  swipe-down-behaviors:
    type: phandle-array
    specifier-space: binding
    required: false

  track-remainders:
    type: boolean
    description: Required by ZMK core input listener macro
```
